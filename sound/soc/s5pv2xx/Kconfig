## sound/soc/s5pv2xx/Kconfig
```kconfig
config SND_S5PV2XX_SOC
	tristate "Samsung S5P Audio Drivers"
	depends on ARCH_S5PV210
	help
	  Say Y or M if you want to add support for codecs attached to
	  the Samsung S5PV210's Audio interfaces. You will also need to
	  select the audio interfaces to support below.

config SND_S5PC1XX_I2S
	tristate

config SND_SOC_WM8960_MINI210
	tristate

config SND_S5PV2XX_SOC_WM8960
	tristate "SoC I2S Audio support for WM8960 on MINI210"
	depends on SND_S5PV2XX_SOC && MACH_MINI210
	select SND_S5PC1XX_I2S
	select SND_SOC_WM8960_MINI210
	help
	  Say Y if you want to add support for SoC audio on MINI210
	  with the WM8960.

config S5P_INTERNAL_DMA
	bool "IIS operate with Internal DMA"
	depends on SND_S5PV2XX_SOC_WM8960
	default y
	help
	  Say Y for IIS to operate with Internal DMA(IIS's own DMA)
```
